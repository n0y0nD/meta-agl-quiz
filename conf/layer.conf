## conf/layer.conf
```bitbake
BBPATH .= ":${LAYERDIR}"

BBFILES = "${LAYERDIR}/recipes-apps/*/*.bb"

BBFILE_COLLECTIONS += "meta-agl-quiz"
BBFILE_PATTERN_meta-agl-quiz = "^${LAYERDIR}/"
BBFILE_PRIORITY_meta-agl-quiz = "6"

LAYERSERIES_COMPAT_meta-agl-quiz = "scarthgap"
```
